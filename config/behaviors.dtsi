/ {
    behaviors {
       homerow: homerow {
            compatible = "zmk,behavior-hold-tap";
            label = "HOMEROW";
            bindings = <&kp>, <&kp>;

            #binding-cells = <2>;
            tapping-term-ms = <150>;
            quick-tap-ms = <0>;
            flavor = "tap-preferred";
        };
    };
};
